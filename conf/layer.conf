## conf/layer.conf
```bitbake
# We have a conf and classes directory, add to BBPATH
BBPATH .= ":${LAYERDIR}"

# We have recipes-* directories, add to BBFILES
BBFILES += "${LAYERDIR}/recipes-*/*/*.bb \
            ${LAYERDIR}/recipes-*/*/*.bbappend"

BBFILE_COLLECTIONS += "meta-mogbe"
BBFILE_PATTERN_meta-mogbe = "^${LAYERDIR}/"
BBFILE_PRIORITY_meta-mogbe = "6"

LAYERDEPENDS_meta-mogbe = "core"
LAYERSERIES_COMPAT_meta-mogbe = "scarthgap"
```
